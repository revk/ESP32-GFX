## Kconfig
```kconfig
menu "GFX"

	choice
		prompt "Driver"

	config GFX_BUILD_SUFFIX_GFXNONE
		bool "No GFX driver"

	config GFX_BUILD_SUFFIX_SSD1351
		bool "SSD1351 - e.g. 1.5in RGB OLED 128x128 16bpp"

	config GFX_BUILD_SUFFIX_SSD1680
		bool "SSD1680 - e.g. 2.13in epaper 250x122 1bpp"

	config GFX_BUILD_SUFFIX_SSD1681
		bool "SSD1681 - e.g. 1.54in epaper 200x200 1bpp"

	config GFX_BUILD_SUFFIX_EPD75K
		bool "Waveshare 7.5in epaper 800x480 1bpp"

	config GFX_BUILD_SUFFIX_EPD75R
		bool "Waveshare 7.5in epaper 800x480 1bpp+1bpp red"

	config GFX_BUILD_SUFFIX_EPD154K
		bool "Waveshare 1.54in epaper 200x200 1bpp"

	config GFX_BUILD_SUFFIX_EPD154R
		bool "Waveshare 1.54in epaper 200x200 1bpp+1bpp red"

	config GFX_BUILD_SUFFIX_EPD29K
		bool "Waveshare 2.9in epaper 128x296  1bpp+1bpp"

	config GFX_BUILD_SUFFIX_LED24
		bool "Waveshare 2.4in LCD 240x320 16bpp"

	endchoice

	config GFX_WIDTH
	int "Width (pixels)"
	default 0
	help
		GFX display width (0 for default for driver)

	config GFX_HEIGHT
	int "Height (pixels)"
	default 0
	help
		GFX display height (0 for default for driver)

	config GFX_TUNING
	bool "Additional settings to fine tune GFX"
	default y 
	help
		Enable fine tuning settings (RevK library)

	config GFX_7SEG
	bool "Include 7 seg font"
	default y 
	help
		7 segment digit fonts (all sizes)

	config GFX_UNICODE
	bool "Include additional unicode characters"
	default y 
	help
		Additional Unicode characters (experimental)

	config GFX_CS
	int "GPIO pin for CS"
	default 0
	help
		GPIO pin for CS (0 means not set)

	config GFX_DC
	int "GPIO pin for DC"
	default 0
	help
		GPIO pin for DC (0 means not set)

	config GFX_SCK
	int "GPIO pin for SCK"
	default 0
	help
		GPIO pin for SCK (0 means not set)

	config GFX_MISO
	int "GPIO pin for MISO"
	default 0
	help
		GPIO pin for MISO (0 means not set)

	config GFX_MOSI
	int "GPIO pin for MOSI"
	default 0
	help
		GPIO pin for MOSI (0 means not set)

	config GFX_RST
	int "GPIO pin for RST"
	default 0
	help
		GPIO pin for RST (0 means not set)

	config GFX_ENA
	int "GPIO pin for ENA"
	default 0
	help
		GPIO pin for EN (0 means not set)

	config GFX_BUSY
	int "GPIO pin for BUSY"
	default 0
	help
		GPIO pin for BUSY (0 means not set)

	config GFX_FLIP
	int "Default flip settings"
	default 0
	help
		Display flip logic

endmenu
```
